## config/boards/shields/KobitoKey/Kconfig.defconfig
```kconfig
# 左（central / stock）
if SHIELD_KOBITOKEY_LEFT
config ZMK_KEYBOARD_NAME
    default "KobitoKey"
endif

# 左（central / DYA）
if SHIELD_KOBITOKEY_LEFT_DYA
config ZMK_KEYBOARD_NAME
    default "KobitoKeyDYA"
endif

# 左右共通（stock + DYA）
if SHIELD_KOBITOKEY_LEFT || SHIELD_KOBITOKEY_RIGHT || SHIELD_KOBITOKEY_LEFT_DYA || SHIELD_KOBITOKEY_RIGHT_DYA
config ZMK_SPLIT
    default y
config ZMK_POINTING
    default y
config SPI
    default y
endif
```

## config/boards/shields/KobitoKey/Kconfig.shield
```kconfig
config SHIELD_KOBITOKEY_LEFT
    def_bool $(shields_list_contains,KobitoKey_left)

config SHIELD_KOBITOKEY_RIGHT
    def_bool $(shields_list_contains,KobitoKey_right)

# --- DYA Studio 派生 ---
config SHIELD_KOBITOKEY_LEFT_DYA
    def_bool $(shields_list_contains,KobitoKey_left_dya)

config SHIELD_KOBITOKEY_RIGHT_DYA
    def_bool $(shields_list_contains,KobitoKey_right_dya)
```

## config/west.yml
```yaml
manifest:
  remotes:
    - name: cormoran
      url-base: https://github.com/cormoran
    - name: caksoylar
      url-base: https://github.com/caksoylar

  projects:
    # ===== Custom Studio Protocol 対応 ZMK / Zephyr =====
    - name: zmk
      remote: cormoran
      revision: main+dya
      import:
        file: app/west.yml
    - name: zephyr
      remote: cormoran
      revision: v4.1.0+zmk-fixes+nrf-half-duplex-uart
      clone-depth: 1
      import:
        name-blocklist:
          - ci-tools
          - hal_altera
          - hal_cypress
          - hal_infineon
          - hal_microchip
          - hal_nxp
          - hal_openisa
          - hal_xtensa
          - hal_st
          - hal_ti
          - loramac-node
          - mcuboot
          - mcumgr
          - net-tools
          - openthread
          - edtt
          - trusted-firmware-m

    # ===== コアモジュール =====
    - name: zmk-feature-custom-settings
      remote: cormoran
      revision: main
    - name: zmk-feature-fast-keymap
      remote: cormoran
      revision: main

    # ===== Keymap / Macro / Combo =====
    - name: zmk-feature-runtime-macro
      remote: cormoran
      revision: main
    - name: zmk-feature-runtime-combo
      remote: cormoran
      revision: main
    - name: zmk-feature-module-physical-layout
      remote: cormoran
      revision: main

    # ===== Trackball =====
    - name: zmk-driver-pmw3610-with-custom-studio-rpc
      remote: cormoran
      revision: main
    - name: zmk-module-runtime-input-processor
      remote: cormoran
      revision: main

    # ===== Connection =====
    - name: zmk-module-ble-management
      remote: cormoran
      revision: main
    - name: zmk-feature-default-layer
      remote: cormoran
      revision: codex/custom-rpc-rewrite
    - name: zmk-feature-os-detection
      remote: cormoran
      revision: main

    # ===== Settings =====
    - name: zmk-module-settings-rpc
      remote: cormoran
      revision: main

    # ===== LED =====
    - name: zmk-rgbled-widget
      remote: caksoylar
      revision: main

  self:
    path: config
```
